## target/linux/realtek/files-4.14/drivers/net/rtl819x/Kconfig
```kconfig
menuconfig RTL_819X_SWCORE
        bool "akash interfaces support"
        ---help---
          Wide Area Networks (WANs), such as X.25, Frame Relay and leased
          lines, are used to interconnect Local Area Networks (LANs) over vast
          distances with data transfer rates significantly higher than those
          achievable with commonly used asynchronous modem connections.

          Usually, a quite expensive external device called a `WAN router' is
          needed to connect to a WAN. As an alternative, a relatively
          inexpensive WAN interface card can allow your Linux box to directly
          connect to a WAN.

          If you have one of those cards and wish to use it under Linux,
          say Y here and also to the WAN driver for your card.

          If unsure, say N.

if RTL_819X_SWCORE

config DEFAULTS_KERNEL_2_6
        bool
        default y

config AUTO_DHCP_CHECK
        bool "Auto DHCP Check"
        default n

config NEW_PCI
        bool "NEW_PCI"
        default y
        depends on PCI

config RTL_IGMP_PROXY
        bool "RTL_IGMP_PROXY"
        default y

config RTL_IGMP_SNOOPING
        bool "RTL_IGMP_SNOOPING"
        default y
        depends on BRIDGE
        depends on !BRIDGE_IGMP_SNOOPING

config RTL_MLD_SNOOPING
        bool "RTL_MLD_SNOOPING"
        default y
        depends on RTL_IGMP_SNOOPING

config RTL_QUERIER_SELECTION
        bool "RTL_QUERIER_SELECTION"
        default y
        depends on RTL_IGMP_SNOOPING

config RTL_MLD_PROXY
    bool "RTL_MLD_PROXY"
    default y

config RTL_LINKCHG_PROCESS
        bool "RTL_LINKCHG_PROCESS"
        default y

config RTL_DEBUG_TOOL
        bool "RTL_DEBUG_TOOL"
        default y

config RTL_EEE_DISABLED
        bool "Disable 802.3az EEE feature"
        default n
        depends on RTL_819X && !RTL_8370_SUPPORT

config RTL_PROC_DEBUG
        bool "Enable proc filesystem for debug"
        default n
        depends on RTL_819X

menu "Config for Layered Driver Features"
	config RTL_LAYERED_DRIVER
        	bool
	        default y
        	depends on RTL_819X

	config RTL_LAYERED_ASIC_DRIVER
                bool
                default n
                depends on RTL_LAYERED_DRIVER
	
	config RTL_LAYERED_ASIC_DRIVER_L3
                bool
                default n
                depends on RTL_LAYERED_ASIC_DRIVER

	config RTL_LAYERED_ASIC_DRIVER_L4
                bool
                default n
		depends on RTL_LAYERED_ASIC_DRIVER
		depends on RTL_8198 || RTL_8196CT || RTL_8198T || RTL_8198C || RTL_8197F

	config RTL_LAYERED_DRIVER_ACL
		bool
		default n
		depends on RTL_LAYERED_DRIVER

	config RTL_LAYERED_DRIVER_L2
		bool
		default n
		depends on RTL_LAYERED_DRIVER

	config RTL_HW_QOS_SUPPORT
		bool
                default n
		depends on RTL_LAYERED_DRIVER
		depends on RTL_8196CT || RTL_8198T || RTL_8198 || RTL_819XDT || RTL_8198C || RTL_8197F

	config RTL_LAYERED_DRIVER_L3
		bool
                default n
                depends on RTL_LAYERED_DRIVER


	config RTL_LAYERED_DRIVER_L4
		bool
                default n
		depends on RTL_LAYERED_DRIVER
		depends on RTL_8198 || RTL_8196CT || RTL_8198T || RTL_8198C || RTL_8197F
	
	comment 'Choose basic features.'

        config RTL_LINKCHG_PROCESS
		bool
                default n 
                depends on RTL_LAYERED_DRIVER

        config RTL_EXTPORT_VLANID
       	        int
               	default "9"
                depends on RTL_LAYERED_DRIVER

	comment 'Choose hardware features.'	
	
	choice  
       		prompt "Hardware Features Selection"
        	default RTL_HW_MULTICAST_ONLY
		depends on RTL_LAYERED_DRIVER

	config RTL_HW_NAPT
		bool "Enable RTL Hardware NAPT"
		depends on RTL_8198 || RTL_8196CT || RTL_8198T || RTL_819XDT || RTL_8367R_SUPPORT || RTL_89xxD || RTL_8196C || RTL_8196E || RTL_819XD || RTL_8198C || RTL_8197F
		select RTL_LAYERED_ASIC_DRIVER
		select RTL_LAYERED_ASIC_DRIVER_L3
		select RTL_LAYERED_ASIC_DRIVER_L4
		select RTL_LAYERED_DRIVER_ACL
		#select RTL_HW_QOS_SUPPORT
		select RTL_LAYERED_DRIVER_L2
                select RTL_LAYERED_DRIVER_L3
                select RTL_LAYERED_DRIVER_L4
                select RTL_HARDWARE_MULTICAST if RTL_IGMP_SNOOPING
		select RTL_HARDWARE_NAT
	
	config RTL_HW_MULTICAST_ONLY
		bool "Enable RTL Hardware Multicast Only"
		depends on !RTL_8370_SUPPORT
		select RTL_LAYERED_ASIC_DRIVER
		select RTL_LAYERED_ASIC_DRIVER_L3
		select RTL_LAYERED_DRIVER_ACL
		select RTL_LAYERED_DRIVER_L2
                select RTL_LAYERED_DRIVER_L3
		select RTL_HARDWARE_MULTICAST

	config RTL_HW_L2_ONLY
		bool "Enable RTL Hardware switch Only"
		select RTL_LAYERED_ASIC_DRIVER		
		select RTL_LAYERED_DRIVER_ACL		#because mld snooping need add acl to trap ipv6 multicast packet to cpu
		select RTL_LAYERED_DRIVER_L2
	
	endchoice
	        
	comment 'Choose advance features.'	
#	config RTL_L2_HW_MULTICAST_SUPPORT
#		bool "RTL l2 hw multicast support"
#		default n
#		depends on RTL_HARDWARE_MULTICAST

	config RTL_HW_MCAST_PATCH_FOR_MAC
       		 #bool "RTL Hardware Multicast patch for Mac address"
			 default y
       		 depends on RTL_HARDWARE_MULTICAST && !OPENWRT_SDK
		 depends on RTL_8196E || RTL_8881A || RTL_8198C || RTL_8197F
	
	config RTL_HW_MCAST_WIFI
        	bool "Support hw multiast for eth+wlan client"
        	depends on RTL_HARDWARE_MULTICAST  
	
		
	config RTL_EXT_PORT_SUPPORT
		bool "Enable extension port support"
		default n
		depends on RTL_HW_NAPT && !OPENWRT_SDK
		
	config RTL_NETIF_MAPPING
                default y
                depends on RTL_LAYERED_DRIVER

	config RTL_MULTIPLE_WAN
                bool "Enable multiple wan in hw nat mode"
                default n
                depends on RTL_HARDWARE_NAT && !OPENWRT_SDK
		depends on RTL_8198T || RTL_8196CT || RTL_819XDT || RTL_8198C || RTL_8197F

#	config RTL865X_LANPORT_RESTRICTION
#		bool "Rtl865x lan port restriction"
#		default n
#		depends on RTL_LAYERED_DRIVER

	config RTL_IVL_SUPPORT
		bool "Support multi-vlan in bridge/wisp mode"
                default n
                depends on RTL_LAYERED_DRIVER && !RTL_8370_SUPPORT
    
	#config RTL_LOCAL_PUBLIC
	#	bool "Enable RTL local public"
	#	default n
	#	depends on RTL_HW_NAPT

	config RTL_HW_DSLITE_SUPPORT
		bool "Enable HW DS-LITE SUPPORT"
			default n
			depends on RTL_LAYERED_DRIVER && !OPENWRT_SDK
			depends on RTL_8198C || RTL_8197F

	config RTL_HW_6RD_SUPPORT
		bool "Enable HW 6RD SUPPORT"
			default n
			depends on RTL_LAYERED_DRIVER && !OPENWRT_SDK
			depends on RTL_8198C || RTL_8197F

	config RTL_TSO
		bool "Enable hardware TSO support(GSO is needed)"
		default n
		depends on RTL_8197F
		select RTL_GSO		
		
	config RTL_GSO
		bool "Enable software GSO support"
		default y if RTL_8198C || RTL_819XD || RTL_8881A 
		depends on RTL_8197F || RTL_8198C || RTL_819XD || RTL_8881A 

#	config RTL_HW_TX_CSUM
#		bool "Enable Ethernet hardware Tx checksum offload"
#		default n
#		depends on RTL_8198C && !OPENWRT_SDK

#	config RTL_ETH_TX_SG
#		bool "Enable Ethernet TX SG support"
#		default n
#		depends on RTL_8198C && !OPENWRT_SDK
	
endmenu

endif #RTL_819X_SWCORE
```
